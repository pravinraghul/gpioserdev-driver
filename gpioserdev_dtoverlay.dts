/dts-v1/;
/plugin/;

/ {
    compatible = "brcm,bcm2835";

    fragment@0 {
        target = <&soc>;
        __overlay__ {
            gpioserdev: gpioserdev {
                compatible = "pravin,gpioserdev";
                status = "okay";

                /* GPIO pin definitions */
               	strobe-pin = <&gpio 19 0>;    /* GPIO 19 as strobe pin */
                data-pin = <&gpio 16 0>;   /* GPIO 16 as data pin */
            };
        };
    };
};