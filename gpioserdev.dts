/dts-v1/;
/plugin/;

/ {
    compatible = "brcm,bcm2835";

    fragment@0 {
        target = <&gpio>;
        __overlay__ {
            gpioserdev {
                compatible = "gpioserdev";
                gpios = <&gpio 16 0>, <&gpio 19 0>;
                strobe-gpios = <&gpio 19 0>;
                data-gpios = <&gpio 16 0>;
            };
        };
    };
};
